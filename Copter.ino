#include <SPI.h>
#include <Gamebuino.h>
Gamebuino gb;



extern const byte font3x3[]; //a really tiny font
extern const byte font3x5[]; //a small but efficient font (default)


const byte Ville1[] PROGMEM = {48,40,0x0,0x0,0x0,0x3,0x0,0x0,0x0,0x0,0x0,0x5,0x80,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0xC0,};
const byte Ville2[] PROGMEM = {48,40,0x0,0x0,0x0,0x0,0x0,0x0,0x0,0x60,0x0,0x0,0x0,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0xC0,};
const byte Ville3[] PROGMEM = {48,40,0x0,0x0,0x0,0x0,0x0,0x0,0x0,0x0,0x0,0x1,0x80,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0xC0,};
const byte Ville4[] PROGMEM = {48,40,0x0,0x30,0x0,0x0,0x0,0x0,0x0,0x68,0x0,0x0,0x0,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0xC0,};
const byte Ville5[] PROGMEM = {48,40,0x0,0x0,0x0,0x0,0x0,0x0,0x0,0x0,0x0,0x0,0x0,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0xC0,};
const byte Ville6[] PROGMEM = {48,40,0x0,0x0,0x0,0x3,0x0,0x0,0x0,0x0,0x0,0x5,0x80,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0xC0,};
const byte Ville7[] PROGMEM = {48,40,0x0,0x0,0x0,0x0,0x0,0x0,0x0,0x0,0x0,0x1,0x80,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0xC0,};
const byte Ville8[] PROGMEM = {48,40,0x0,0x0,0x0,0x0,0x0,0x0,0x0,0x0,0x0,0x0,0x0,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0xC0,};

//sprite ennemies
const byte Char1[] PROGMEM = {16,8,0x1,0x0,0x0,0xC0,0x3,0xF0,0xFE,0x10,0x2,0x10,0xF,0xF8,0x1A,0x2C,0xF,0xF8,};
const byte Char1C[] PROGMEM = {16,8,0x0,0x0,0x6,0x0,0x9,0x70,0x11,0xD0,0x23,0x10,0x47,0xF8,0x1A,0x2C,0x3F,0xF8,};
const byte Char2[] PROGMEM = {24,10,0x0,0x3C,0x0,0x7F,0xC2,0x0,0x0,0x82,0x0,0xF,0x83,0x80,0x12,0xFD,0x40,0x21,0x2,0x20,0x20,0x0,0x20,0x1F,0xFF,0xC0,0xA,0xAA,0x80,0x7,0xFF,0x0,};
const byte Char2C[] PROGMEM = {24,10,0x0,0x0,0x0,0x1F,0x0,0x0,0x21,0x0,0x0,0x4F,0x85,0x80,0x53,0x4B,0x40,0x21,0x32,0x20,0x20,0x84,0x20,0x1F,0xFF,0xC0,0xA,0xAA,0x80,0x7,0xFF,0x0,};
const byte Halftrack[] PROGMEM = {24,10,0x0,0xA,0x80,0x0,0x5,0x40,0x1,0xFA,0xA0,0x1,0x9,0x50,0x7F,0x8,0xA8,0xC0,0xF7,0xF8,0x7C,0x0,0x18,0x57,0xFF,0xF0,0x28,0x2A,0xA8,0x10,0x1F,0xF0,};
const byte Halftrack1c[] PROGMEM = {24,10,0x1,0x0,0x80,0x62,0x80,0x40,0x5C,0x40,0xA0,0x88,0x20,0x50,0x48,0x40,0x28,0x27,0x80,0xF8,0x3C,0x83,0x18,0x16,0x7F,0xF0,0x2A,0x2A,0xA8,0x11,0x5F,0xF0,};
const byte Halftrack2[] PROGMEM = {24,10,0x7,0xEF,0xF8,0x0,0x5A,0xA8,0x1,0xFD,0x58,0x1,0xA,0xA8,0x7F,0xD,0x58,0xC0,0xF7,0xF8,0x7C,0x0,0x18,0x57,0xFF,0xF0,0x28,0x2A,0xA8,0x10,0x1F,0xF0,};
const byte Halftrack2C[] PROGMEM = {24,10,0x8,0x0,0x78,0x4,0x20,0xA8,0x2,0x51,0x58,0x1,0x9A,0xA8,0xF,0x2D,0x58,0x70,0xF7,0xF8,0x40,0x0,0x18,0xDD,0xFF,0xF0,0x66,0x2A,0xA8,0x44,0x1F,0xF0,};
const byte jeep[] PROGMEM = {16,10,0x20,0x0,0x50,0x0,0xA0,0x0,0x40,0x40,0x44,0x40,0xFC,0x78,0xFF,0xF8,0xAF,0x78,0x50,0xA0,0x20,0x40,};
const byte jeepC[] PROGMEM = {16,10,0x0,0x0,0x0,0x0,0x2,0x0,0xD,0x0,0x12,0x80,0x25,0x0,0xEC,0xE0,0xFF,0xF0,0xAF,0x78,0x70,0xE0,};

const byte HeliPort[] PROGMEM = {24,8,0x80,0x18,0xC0,0xC0,0xC,0x60,0x60,0x6,0x30,0x30,0x8F,0x18,0x18,0xD9,0xC,0xC,0x70,0x6,0x6,0x30,0x3,0x3,0x18,0x1,};

//Explosion ennemies
const byte Explosion1[] PROGMEM = {16,24,0x0,0x0,0x0,0x0,0x0,0x0,0x0,0x0,0x0,0x0,0x0,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0x3F,};
const byte Explosion2[] PROGMEM = {16,24,0x0,0x0,0x0,0x0,0x0,0x0,0x0,0x0,0x0,0x0,0x0,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0xBF,};
const byte Explosion3[] PROGMEM = {16,24,0x3,0xC0,0x5,0xA0,0x1B,0xD8,0x27,0xE4,0x4F,0xF2,0xDD,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0x3F,};


#define NB_EXPLOSION_ENNEMI 3
#define MAX_LIFE 10

typedef struct {
  byte etat, frequence;
  unsigned int posX;
  byte const * Ex1;
  byte const * Ex2;
  byte const * Ex3;
}
Explosion;
Explosion exEnn = {NB_EXPLOSION_ENNEMI+1,5,0,Explosion1, Explosion2, Explosion3};

#define FRAMERATE 41
#define TIME_TO_REGENERE (FRAMERATE*2)
#define TIME_TO_ENRAYE FRAMERATE
typedef struct {
  int8_t hp,nbClient,offsetCam,timeMitraille,timeRegenere;
  float vx,vy,x, y,angle,angleSprite,etat; //etat < 1 : vise a droite; etat >1   vise au centre ; etat > 2 vise a gauche
  bool dir, dirSprite,mitraille,isEnrayer;
  int impact;
  
}
Copter;


typedef struct {
  int8_t etat;//0 mort, 1 safe , 2 in copter , 3 alive
  int x,tx,y; 
}
Rescape;

#define NB_RESC 33
#define NB_MAX_RESC_IN_COPTER 8
Rescape lesRescape[NB_RESC];
uint8_t cptVictoire;
uint8_t cptDeath;
#define NB_LIFE 2
uint8_t vieRestant = NB_LIFE;

typedef struct {
  uint8_t type;//permet de savoir sur quel sprite on est 0 : heliport,   1 -> 49 bat deco , >49 bat attaque
  unsigned int posX,posY;
  uint8_t height;
  byte const * sprite;
  byte const * spriteDamage;
  int8_t life;
  int8_t cadance;
  int8_t damage;
}
Batiment;

#define GRAVITE 0.025
#define TIME_ALIVE_BOULET 120
#define TIME_ALIVE_MITRAILLE 60

typedef struct {
  int8_t timerAlive;
  int8_t damage,isGravity;
  float x,y, vx,vy; 
}
Missile;
#define V_MISSILE10 200
#define V_MISSILE 2
#define NB_MISSIBLE 10
Missile lesMissiles[NB_MISSIBLE];

#define NB_BAT_LVL 31
Batiment lesBat[NB_BAT_LVL] = {
           {60,500,48,10,jeep,jeepC,127,2,MAX_LIFE},// ennemie anti bug de l'integer negatif ;)
           {0,1010,48,8,HeliPort,HeliPort,10,0,0},
           {50,1200,70,10,jeep,jeepC,5,5,2},
           {51,1110,80,10,Halftrack,Halftrack1c,15,10,3},
           {53,1150,60,8,Char1,Char1C,25,15,6},
           {54,1350,70,10,Char2,Char2C,35,20,7},
           {53,1410,90,8,Char1,Char1C,25,15,6},
           {50,1500,80,10,jeep,jeepC,5,5,2},
           {52,1620,60,10,Halftrack2,Halftrack2C,15,10,3},
           {51,1700,70,10,Halftrack,Halftrack1c,15,10,4},
           {50,1800,60,10,jeep,jeepC,5,5,2},
           {54,1950,90,10,Char2,Char2C,40,20,7},
           {52,2200,60,10,Halftrack2,Halftrack2C,15,10,4},
           {52,2315,120,10,Halftrack2,Halftrack2C,15,10,4},
           {51,2450,60,10,Halftrack,Halftrack1c,15,10,3},
           {53,2575,90,8,Char1,Char1C,25,15,6},
           {54,2650,80,10,Char2,Char2C,35,20,7},
           {53,2780,70,8,Char1,Char1C,25,15,6},
           {50,2800,120,10,jeep,jeepC,5,5,2},
           {52,2850,80,10,Halftrack2,Halftrack2C,15,10,4},
           {51,2880,55,10,Halftrack,Halftrack1c,15,10,3},
           {50,2900,75,10,jeep,jeepC,5,5,2},
           {54,2960,60,10,Char2,Char2C,40,20,7},
           {52,3000,65,10,Halftrack2,Halftrack2C,15,10,4},
           {53,3075,85,8,Char1,Char1C,25,15,6},
           {54,3150,90,10,Char2,Char2C,35,20,7},
           {53,3100,70,8,Char1,Char1C,25,15,6},
           {52,3180,60,10,Halftrack2,Halftrack2C,15,10,4},
           {51,3200,100,10,Halftrack,Halftrack1c,15,10,3},
           {0,3250,48,8,HeliPort,HeliPort,10,0,0},
           {60,6000,48,10,jeep,jeepC,127,2,MAX_LIFE}// ennemie anti bug de l'integer negatif ;)
         };
         
Copter player;

//le fond 
#define NB_FOND 8
byte const * leFond[NB_FOND] = {Ville1,Ville5,Ville3,Ville7,Ville2,Ville8,Ville6,Ville4};

void setup()
{
  gb.begin();
  goTitleScreen();
  gb.setFrameRate(FRAMERATE);
}

void initGame()
{
  gb.battery.show = false;
   for(byte i=0;i<NB_BAT_LVL;i++)
   {
     switch (lesBat[i].type)
     {
       case 50 : 
       lesBat[i].life = 5;
       break;
       case 51 : 
       lesBat[i].life = 15;
       break;
       case 52 : 
       lesBat[i].life = 15;
       break;
       case 53 : 
       lesBat[i].life = 25;
       break;
       case 54 : 
       lesBat[i].life = 35;
       break;
       default : 
       lesBat[i].life = 127;
       
       break;
     }
   }
   vieRestant = 2;
   player.hp = MAX_LIFE;
  player.x=1000;
  cptVictoire= 0;
  cptDeath = 0;
  player.etat=3;
  player.offsetCam = 42;
  
  //TODO aleatoire pour le moment
  for(uint8_t i =0;i<NB_RESC;i++)
  {
     lesRescape[i].etat = 3;
     lesRescape[i].x = random(1100,3100);
     lesRescape[i].y = random(39,44);
     lesRescape[i].tx = lesRescape[i].x;
  }
  for(byte i=0;i<NB_MISSIBLE;i++)
  {
    lesMissiles[i].timerAlive = 0;
  }
}

void loop(){

 if(gb.update())
 {
    if(gb.buttons.pressed(BTN_C)){
      goTitleScreen();
    }
    if((cptVictoire + cptDeath)< NB_RESC && vieRestant>0) 
    {
      updatePlayer();
      updateRescaper();
      updateBatiment();
      updateMissile();
      updateExplosion();
      drawWorld();
      drawMissile();
      drawEnnemies();
      drawPlayer();
      drawRescaper();
      drawExplosion();
      drawHud();
    }
    else 
    {
      winScreen();
    }
 }
 // gameOverScreen();
}

void drawWorld()
{
   gb.display.setColor(GRAY);
   for(int i=0;i<3;i++)
   {
     uint8_t index = ((((int)player.x/42)%8)+i)%8;
     int indexImageX = (42*i)-((int)player.x%42);
     gb.display.drawBitmap( indexImageX,0,leFond[index]);
   }
   
   gb.display.setColor(BLACK);
   gb.display.drawFastHLine(0, 39, 84);
}



const uint8_t soundfx[3][8] = {
    {1,4,113,10,7,19,7,52}, // Explosion{1,0,55,12,7,12,7,13}
    {1,36,12,1,7,0,7,10}, // Mittrailleuse {1,14,24,7,7,0,7,10}
    {0,25,1,1,7,0,7,9},
};

void playsoundfx(uint8_t fxno, uint8_t channel) {
    gb.sound.command(0,soundfx[fxno][6],0,channel);
    // set volume
    gb.sound.command(1,soundfx[fxno][0],0,channel);
    // set waveform
    gb.sound.command(2,soundfx[fxno][5],-soundfx[fxno][4],channel);
    // set volume slide
    gb.sound.command(3,soundfx[fxno][3],soundfx[fxno][2]-58,channel);
    // set pitch slide
    gb.sound.playNote(soundfx[fxno][1],soundfx[fxno][7],channel);
    // play note
}

